## Firmware/Spectacle_Director_Firmware/main/Kconfig.projbuild
```kconfig
menu "LED Configuration"

config LED_STATUS
    int "Status LED GPIO number"
	range 0 34
	default 5
	help
		GPIO number (IOxx) connected to BLUE status indicator LED.

		Some GPIOs are used for other purposes (flash connections, etc.) and cannot be used to blink.

		GPIOs 35-39 are input-only so cannot be used as outputs.

config LED_CONNECT
    int "Connection LED GPIO number"
	range 0 34
	default 13
	help
		GPIO number (IOxx) connected to GREEN status indicator LED.

		Some GPIOs are used for other purposes (flash connections, etc.) and cannot be used to blink.

		GPIOs 35-39 are input-only so cannot be used as outputs.

endmenu
```
